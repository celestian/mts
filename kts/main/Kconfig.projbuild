## kts/main/Kconfig.projbuild
```kconfig
menu "MTS Configuration / KTS"

    orsource "$IDF_PATH/examples/common_components/env_caps/$IDF_TARGET/Kconfig.env_caps"

    config GPIO_OUTPUT_0
        int "GPIO LED pin"
        range ENV_GPIO_RANGE_MIN ENV_GPIO_OUT_RANGE_MAX
        default 1
        help
            GPIO pin number to be used as LED diode.

    config GPIO_INPUT_0
        int "GPIO BUTTON pin"
        range ENV_GPIO_RANGE_MIN ENV_GPIO_IN_RANGE_MAX
        default 2
        help
            GPIO pin number to be used as BUTTON.

endmenu
```
